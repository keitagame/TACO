/* エントリポイント（最初に実行する関数・ラベル）を指定 */
ENTRY(_start)

SECTIONS
{
    /* 1. カーネルのロード先アドレスを設定（x86自作OSでは1MB [0x100000] が標準） */
    . = 1M;

    /* 2. テキスト（コード）セクション */
    .text :
    {
        /* マルチブートヘッダーをバイナリの最先頭に強制配置 */
        KEEP(*(.multiboot))
        
        *(.text)
    }

    /* 3. 読み取り専用データ（文字列定数など） */
    .rodata :
    {
        *(.rodata)
    }

    /* 4. 初期化済みデータ（グローバル変数など） */
    .data :
    {
        *(.data)
    }

    /* 5. 未初期化データ（スタックやBSS領域） */
    .bss :
    {
        *(COMMON)
        *(.bss)
    }
    
}
